## west.yml
```yaml
# SPDX-License-Identifier: LGPL-2.1-or-later

manifest:
  self:
    path: sensitive-idiot

  remotes:
    - name: zephyrproject-rtos
      url-base: https://github.com/zephyrproject-rtos

  projects:
    - name: zephyr
      remote: zephyrproject-rtos
      revision: main
      import: true
```
